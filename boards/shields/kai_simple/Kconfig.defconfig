## boards/shields/kai_simple/Kconfig.defconfig
```kconfig
if SHIELD_KAI_SIMPLE_DONGLE

config ZMK_KEYBOARD_NAME
    default "Kai Simple"

config ZMK_SPLIT_ROLE_CENTRAL
    default y

config ZMK_SPLIT
    default y

# Set this to the number of peripherals your dongle will have.
# For a unibody, this would be 1. If you have left and right halves, set it to 2, etc.
config ZMK_SPLIT_BLE_CENTRAL_PERIPHERALS
    default 2

# Set this to ZMK_SPLIT_BLE_CENTRAL_PERIPHERALS + your desired number of BT profiles (default is 5)
config BT_MAX_CONN
    default 3

# Set this to the same number as BT_MAX_CONN
config BT_MAX_PAIRED
    default 3

endif

if SHIELD_KAI_SIMPLE_LEFT || SHIELD_KAI_SIMPLE_RIGHT

config ZMK_SPLIT
    default y

endif
```

## boards/shields/kai_simple/Kconfig.shield
```kconfig
config SHIELD_KAI_SIMPLE_LEFT
    def_bool $(shields_list_contains,kai_simple_left)

config SHIELD_KAI_SIMPLE_RIGHT
    def_bool $(shields_list_contains,kai_simple_right)

config SHIELD_KAI_SIMPLE_DONGLE
    def_bool $(shields_list_contains,kai_simple_dongle)
```
